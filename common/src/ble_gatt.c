#include "ble_gatt.h"
#include <zephyr/bluetooth/gatt.h>
#include <zephyr/logging/log.h>

LOG_MODULE_REGISTER(ble_gatt, LOG_LEVEL_INF);

static ble_gatt_rx_cb_t app_rx_cb = NULL;

/* Low-level zephyr GATT Characteristic write callback handler */
static ssize_t on_receive(struct bt_conn *conn, const struct bt_gatt_attr *attr,
                          const void *buf, uint16_t len, uint16_t offset, uint8_t flags)
{
    if (len > 0 && app_rx_cb != NULL) {
        app_rx_cb((const uint8_t *)buf, len);
    }
    return len;
}

/* Service Definition happens entirely inside the library! */
BT_GATT_SERVICE_DEFINE(lasertag_svc,
    BT_GATT_PRIMARY_SERVICE(BT_UUID_LASERTAG_SERVICE),
    BT_GATT_CHARACTERISTIC(BT_UUID_LASERTAG_TX_CHAR, 
                           BT_GATT_CHRC_NOTIFY,
                           BT_GATT_PERM_NONE, 
                           NULL, NULL, NULL),
    BT_GATT_CCC(NULL, BT_GATT_PERM_READ | BT_GATT_PERM_WRITE),
    BT_GATT_CHARACTERISTIC(BT_UUID_LASERTAG_RX_CHAR, 
                           BT_GATT_CHRC_WRITE | BT_GATT_CHRC_WRITE_WITHOUT_RESP, 
                           BT_GATT_PERM_WRITE, 
                           NULL, on_receive, NULL)
);

void ble_gatt_init(ble_gatt_rx_cb_t rx_cb)
{
    app_rx_cb = rx_cb;
}

void ble_gatt_notify(struct bt_conn *conn, const uint8_t *data, uint16_t len)
{
    if (!conn) {
        return;
    }

    /* Attribute 2 is the actual Tx Characteristic Value in the array of attributes generated by BT_GATT_SERVICE_DEFINE macros. 
     * [0] = primary service
     * [1] = TX char
     * [2] = TX val
     */
    int err = bt_gatt_notify(conn, &lasertag_svc.attrs[2], data, len);
    if (err) {
        LOG_WRN("Failed to send notification %d", err);
    }
}